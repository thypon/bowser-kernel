## drivers/input/misc/compass/Kconfig
```kconfig
#
# Kconfig for stand-alone compass input device drivers
#

config INV_AK89XX
    tristate "Invensense AKM AK8975/AK8972/AK8963 compass input device drivers"
    depends on I2C && SYSFS && INPUT
    default n
    help
      This driver supports the AKM AK8975/AK8972/AK8963 compass devices.
      This driver can be built as a module. The module will be called
      inv-ak89xx.
```

## drivers/panelEdid/Kconfig
```kconfig
comment "AUO EDID Driver options"

config AUO_EDID
	tristate "Support AUO EDID driver"
	help
	  Driver for AUO EDID.
```

## drivers/staging/bowser_base/Kconfig
```kconfig
menu "Bowser Base"

menuconfig BOWSER_BASE
        tristate "Bowser Base Support"
        help
          Add support for Bowser Base.

if BOWSER_BASE

config BOWSER_BASE_CONTROLLER
	tristate "Bowser base controller driver"
	depends on IO373B_SMBD
	help
	  This enable Bowser base controller which detects base and
	  synchronize info onto it.

source "drivers/staging/bowser_base/io373x-b/Kconfig"

endif # BOWSER_BASE
endmenu
```

## drivers/staging/maya_base/Kconfig
```kconfig
menu "Maya Base"

menuconfig MAYA_BASE
        tristate "Maya Base Support"
        help
          Add support for Maya Base.

if MAYA_BASE

config MAYA_BASE_CONTROLLER
	tristate "Maya base controller driver"
	depends on IO373B_SMBD
	help
	  This enable Maya base controller which detects base and
	  synchronize info onto it.

source "drivers/staging/maya_base/io373x-b/Kconfig"

endif # MAYA_BASE
endmenu
```

## drivers/staging/maya_base/io373x-b/Kconfig
```kconfig
menuconfig IO373B
	tristate "IO373X-B Support"
	help
	  Add support for IO373X-B chip.

if IO373B

config IO373B_DEBUG
	bool "Build with DEBUG flag"
	help

config IO373B_SMBD
	tristate "IO373X-B base (SMBD) driver"
	default y
	help
	  Enable it to enable IO373X-B chip.

	  To compile this driver as a module, choose M here: the
	  module will be called io373b-smbd.

config IO373B_ACPI
	tristate "IO373X-B battery/charger (ACPI info) Support"
	depends on IO373B_SMBD
	select POWER_SUPPLY
	help
	  Enable it if you have batteries or chargers attached to
	  IO373X-B chip.

	  To compile this driver as a module, choose M here: the
	  module will be called io373b-acpi.

config IO373B_PS2
	tristate "IO373X-B PS/2 driver"
	depends on IO373B_SMBD
	select SERIO
	select KEYBOARD_ATKBD
	help
	  Enable it if you have PS/2 keyboard, mouse or touchpad attached
	  to IO373X-B chip.

	  To compile this driver as a module, choose M here: the
	  module will be called io373b-ps2.

endif # IO373B
```
